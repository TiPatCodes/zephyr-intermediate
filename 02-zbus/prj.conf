## CMakeLists.txt
```
cmake_minimum_required(VERSION 3.20.0)

find_package(Zephyr REQUIRED HINTS $ENV{ZEPHYR_BASE})
project(demo_zbus)

target_include_directories(app PRIVATE src)

target_sources(app PRIVATE
    src/main.c
    src/sensor.c
    src/display.c
    src/logger.c
    # src/alarm.c
)
```

## prj.conf
```kconfig
CONFIG_LOG=y
CONFIG_LOG_MODE_IMMEDIATE=y
CONFIG_THREAD_NAME=y

CONFIG_ZBUS=y
CONFIG_ZBUS_CHANNEL_NAME=y
```

## src/main.c
```c
#include <zephyr/kernel.h>
#include <zephyr/logging/log.h>

LOG_MODULE_REGISTER(main, LOG_LEVEL_INF);

int main(void)
{
    LOG_INF("demo 2 start");
    return 0;
}
```

## src/alarm.c
```c
/*
 * Observer #2 - added in STEP 3.
 *
 * Adding this file to CMakeLists.txt is the ENTIRE change.
 * sensor.c is never opened, and never even recompiled.
 */
#include "sensor_iface.h"

#include <zephyr/kernel.h>
#include <zephyr/logging/log.h>

LOG_MODULE_REGISTER(alarm, LOG_LEVEL_INF);

#define ALARM_THRESHOLD_C 30

static void alarm_cb(const struct zbus_channel *chan)
{
    const struct sensor_data *d = zbus_chan_const_msg(chan);

    if (d->temp_c > ALARM_THRESHOLD_C) {
        LOG_WRN("  alarm: %d C is over %d C!", d->temp_c, ALARM_THRESHOLD_C);
    }
}

ZBUS_LISTENER_DEFINE(alarm_lis, alarm_cb);
ZBUS_CHAN_ADD_OBS(sensor_chan, alarm_lis, 5);
```

## src/display.c
```c
/*
 * Observer #1 - a listener.
 * Runs synchronously, in the publisher's context. Note the thread name.
 */
#include "sensor_iface.h"

#include <zephyr/kernel.h>
#include <zephyr/logging/log.h>

LOG_MODULE_REGISTER(display, LOG_LEVEL_INF);

static void display_cb(const struct zbus_channel *chan)
{
    const struct sensor_data *d = zbus_chan_const_msg(chan);

    LOG_INF("  display: %d C (seq=%u) ctx=%s", d->temp_c, d->seq,
            k_thread_name_get(k_current_get()));
}

ZBUS_LISTENER_DEFINE(display_lis, display_cb);
ZBUS_CHAN_ADD_OBS(sensor_chan, display_lis, 3);
```

## src/logger.c
```c
/*
 * Observer #2 - a SUBSCRIBER (contrast with display.c, a listener).
 *
 * A subscriber gets a notification in its own queue and reads the channel
 * later, from its own thread. That means it is allowed to be slow: the
 * k_sleep() below would be unthinkable in a listener, which runs inside
 * the publisher's call to zbus_chan_pub().
 */
#include "sensor_iface.h"

#include <zephyr/kernel.h>
#include <zephyr/logging/log.h>

LOG_MODULE_REGISTER(logger, LOG_LEVEL_INF);

ZBUS_SUBSCRIBER_DEFINE(logger_sub, 2);
ZBUS_CHAN_ADD_OBS(sensor_chan, logger_sub, 4);

static void logger_thread(void *a, void *b, void *c)
{
    ARG_UNUSED(a);
    ARG_UNUSED(b);
    ARG_UNUSED(c);

    const struct zbus_channel *chan;

    while (!zbus_sub_wait(&logger_sub, &chan, K_FOREVER)) {
        struct sensor_data d;

        if (chan != &sensor_chan) {
            continue;
        }

        zbus_chan_read(&sensor_chan, &d, K_MSEC(200));

        LOG_INF("  logger: seq=%u temp=%d ctx=%s", d.seq, d.temp_c,
                k_thread_name_get(k_current_get()));
    }
}

K_THREAD_DEFINE(logger_tid, 1024, logger_thread, NULL, NULL, NULL, 6, 0, 0);
```

## src/sensor.c
```c
/*
 * The producer.
 *
 * Look at the includes: it knows sensor_iface.h and nothing else.
 * No display.h. No alarm.h. It does not know who is listening.
 */
#include "sensor_iface.h"

#include <zephyr/kernel.h>
#include <zephyr/logging/log.h>

LOG_MODULE_REGISTER(sensor, LOG_LEVEL_INF);

/*
 * The channel lives with the interface it implements.
 *
 * ZBUS_OBSERVERS_EMPTY: this producer names NOBODY. Observers attach
 * themselves from their own files. This list never grows.
 */
ZBUS_CHAN_DEFINE(sensor_chan,
		 struct sensor_data,
		 NULL,			/* validator */
		 NULL,			/* user data */
		 ZBUS_OBSERVERS_EMPTY,
		 ZBUS_MSG_INIT(0));

static void sensor_thread(void *a, void *b, void *c)
{
    ARG_UNUSED(a);
    ARG_UNUSED(b);
    ARG_UNUSED(c);

    struct sensor_data d = { .temp_c = 20, .seq = 0 };

    while (1) {
        d.seq++;
        // Drift upward so the alarm threshold is crossed live.
        d.temp_c += 2;

        LOG_INF("publish seq=%u temp=%d", d.seq, d.temp_c);
        zbus_chan_pub(&sensor_chan, &d, K_MSEC(100));

        k_sleep(K_MSEC(700));
    }
}

K_THREAD_DEFINE(sensor_tid, 1024, sensor_thread, NULL, NULL, NULL, 5, 0, 0);
```

## src/sensor_iface.h
```c
/*
 * THE INTERFACE.
 *
 * This header is the contract. The producer depends on it, every observer
 * depends on it, and nobody depends on anybody else.
 */
#pragma once

#include <zephyr/zbus/zbus.h>

struct sensor_data {
    int temp_c;
    uint32_t seq;
};

ZBUS_CHAN_DECLARE(sensor_chan);
```
